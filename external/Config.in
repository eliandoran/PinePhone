## external/Config.in
```kconfig
source "$BR2_EXTERNAL_PINEPHONE_PATH/package/lvgl/Config.in"
source "$BR2_EXTERNAL_PINEPHONE_PATH/package/litehtml/Config.in"
source "$BR2_EXTERNAL_PINEPHONE_PATH/package/phone-ui/Config.in"
source "$BR2_EXTERNAL_PINEPHONE_PATH/package/ov5640-firmware/Config.in"
source "$BR2_EXTERNAL_PINEPHONE_PATH/package/tdlib/Config.in"
source "$BR2_EXTERNAL_PINEPHONE_PATH/package/noto-emoji/Config.in"
source "$BR2_EXTERNAL_PINEPHONE_PATH/package/gpiod-tools/Config.in"
```

## external/package/gpiod-tools/Config.in
```kconfig
config BR2_PACKAGE_GPIOD_TOOLS
	bool "gpiod-tools"
	help
	  libgpiod 2's command-line tools (gpioset, gpioget, gpiodetect,
	  gpioinfo, gpiomon) and their library, for the GPIO character
	  device's v2 interface (the kernel has no v1).

	  Buildroot's libgpiod2 wants kernel headers 5.10 for that
	  interface; libgpiod carries its own copy of them (lib/uapi), so
	  it builds with the Bootlin toolchain's 5.4.

	  https://git.kernel.org/pub/scm/libs/libgpiod/libgpiod.git/
```

## external/package/libetpan/Config.in
```kconfig
config BR2_PACKAGE_LIBETPAN
	bool "libetpan"
	select BR2_PACKAGE_OPENSSL
	help
	  Mail client library: IMAP, SMTP and MIME (the parsing and the
	  making of messages), with TLS from OpenSSL. Built for staging
	  only: the Email app (apps/email) carries it.

	  https://github.com/dinhviethoa/libetpan
```

## external/package/litehtml/Config.in
```kconfig
config BR2_PACKAGE_LITEHTML
	bool "litehtml"
	depends on BR2_INSTALL_LIBSTDCPP
	help
	  HTML and CSS rendering engine: it parses and lays out the
	  page and calls back into the program to draw text, images and
	  boxes. Static library only, with its bundled Gumbo parser.

	  https://github.com/litehtml/litehtml
```

## external/package/lvgl-bench/Config.in
```kconfig
config BR2_PACKAGE_LVGL_BENCH
	bool "lvgl-bench"
	depends on BR2_PACKAGE_LVGL
	help
	  Runs the LVGL benchmark demo full screen on the DRM display,
	  with the FPS/CPU monitor on screen. Not started at boot:
	  /etc/init.d/lvgl-bench start (stop S90phone-ui first);
	  results go to /tmp/lvgl-bench.log.
```

## external/package/lvgl/Config.in
```kconfig
config BR2_PACKAGE_LVGL
	bool "lvgl"
	depends on BR2_TOOLCHAIN_HAS_THREADS
	select BR2_PACKAGE_LIBDRM
	help
	  LVGL graphics library, built as a static library with the
	  configuration in package/lvgl/lv_conf.h (DRM display).

	  https://lvgl.io
```

## external/package/noto-emoji/Config.in
```kconfig
config BR2_PACKAGE_NOTO_EMOJI
	bool "noto-emoji"
	help
	  Google's Noto color emoji as 64 x 64 PNG images, one per
	  emoji, in /usr/share/emoji/<code points in hex>.png
	  (from the emoji-datasource-google package), without
	  U+FE0F in the names and without the skin tones.

	  https://github.com/googlefonts/noto-emoji
```

## external/package/ov5640-firmware/Config.in
```kconfig
config BR2_PACKAGE_OV5640_FIRMWARE
	bool "ov5640-firmware"
	help
	  OmniVision's autofocus firmware for the OV5640 (rear camera),
	  /lib/firmware/ov5640_af.bin. The ov5640 driver uploads it to the
	  sensor's microcontroller, which drives the lens motor.
	  Proprietary, no source.
```

## external/package/phone-ui/Config.in
```kconfig
config BR2_PACKAGE_PHONE_UI
	bool "phone-ui"
	depends on BR2_PACKAGE_LVGL
	select BR2_PACKAGE_LIBPNG # maps: tiles
	select BR2_PACKAGE_LIBCURL # maps: downloads
	select BR2_PACKAGE_LIBCURL_FORCE_TLS
	select BR2_PACKAGE_OPENSSL
	select BR2_PACKAGE_CA_CERTIFICATES
	select BR2_PACKAGE_JPEG # telegram: photos; camera, gallery
	select BR2_PACKAGE_WEBP # browser, books: pictures
	select BR2_PACKAGE_LITEHTML # browser
	select BR2_PACKAGE_ALSA_LIB # music: playback; volume
	select BR2_PACKAGE_MPG123 # music: tags, and its player
	select BR2_PACKAGE_ALSA_LIB_MIXER # volume
	help
	  The feature phone user interface (LVGL on the DRM display,
	  touchscreen input). Started at boot by S90phone-ui; output
	  goes to /tmp/phone-ui.log.
```

## external/package/tdlib/Config.in
```kconfig
config BR2_PACKAGE_TDLIB
	bool "tdlib"
	depends on BR2_INSTALL_LIBSTDCPP
	depends on BR2_TOOLCHAIN_HAS_THREADS
	select BR2_PACKAGE_OPENSSL
	select BR2_PACKAGE_ZLIB
	help
	  Telegram Database Library, the client library for Telegram.
	  Only the JSON interface (libtdjson), in staging: the Telegram
	  plugin app (apps/telegram) carries it, the image does not.

	  https://core.telegram.org/tdlib
```

## external/package/tow-boot/Config.in
```kconfig
config BR2_PACKAGE_TOW_BOOT
	bool "tow-boot"
	depends on BR2_aarch64
	help
	  Tow-Boot for the PinePhone (A64), the release's build, for the
	  microSD card image (pinephone-sd.img): written at 8 KiB, where
	  the boot ROM looks on the card. The eMMC's image has none: there
	  Tow-Boot lives in boot0, written by its own installer or by
	  emmc-install.sh (its boot0 build, /usr/share/tow-boot).

	  https://tow-boot.org/devices/pine64-pinephoneA64.html
```
